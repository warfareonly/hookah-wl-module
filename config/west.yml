## config/west.yml
```yaml
manifest:
  remotes:
    - name: zmkfirmware
      url-base: https://github.com/zmkfirmware
    - name: infused-kim
      url-base: https://github.com/infused-kim
    # Central Dongle with OLED.
    - name: englmaxi
      url-base: https://github.com/englmaxi
    # Split peripheral input relay
    - name: badjeff
      url-base: https://github.com/badjeff
  projects:
    # infused-kim's ZMK repo.
    - name: zmk
      remote: infused-kim
      revision: pr-testing/mouse_ps2_module_base
      import: app/west.yml
   # Module for PS/2 mouse & TP driver
    - name: kb_zmk_ps2_mouse_trackpoint_driver
      remote: infused-kim
      revision: main
    # - name: zmk
    #   remote: zmkfirmware
    #   revision: main
    #   import: app/west.yml
    # Dongle with OLED.
    - name: zmk-dongle-display
      remote: englmaxi
      revision: main
    # Peripheral input relay
    - name: zmk-split-peripheral-input-relay
      remote: badjeff
      revision: main
  self:
    path: config
```
